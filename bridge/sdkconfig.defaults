## bridge/sdkconfig.defaults
```kconfig
# CrowLink default build configuration for the ESP32-C6 Super Mini.
# These seed sdkconfig on first build (idf.py set-target esp32c6).

# --- Console over USB-C (native USB serial/JTAG) ---
CONFIG_ESP_CONSOLE_USB_SERIAL_JTAG=y

# --- Logging ---
CONFIG_LOG_DEFAULT_LEVEL_INFO=y
```

## sdkconfig.defaults
```kconfig
# CrowMotion default build configuration, shared by all supported targets
# (esp32c3, esp32s3, esp32c6 Super Mini boards).
# These seed sdkconfig on first build. Override locally with `idf.py menuconfig`;
# do not commit the generated sdkconfig (it is gitignored).

# Target is set on the command line: idf.py set-target esp32c3|esp32s3|esp32c6
# The board profile follows the target (see main/Kconfig.projbuild).

# --- Bluetooth: NimBLE host, peripheral only ---
CONFIG_BT_ENABLED=y
CONFIG_BT_NIMBLE_ENABLED=y
CONFIG_BT_NIMBLE_ROLE_PERIPHERAL=y
CONFIG_BT_NIMBLE_ROLE_BROADCASTER=y
CONFIG_BT_NIMBLE_ROLE_CENTRAL=n
CONFIG_BT_NIMBLE_ROLE_OBSERVER=n

# Advertised device name (the radio sees this as the trainer source).
CONFIG_BT_NIMBLE_SVC_GAP_DEVICE_NAME="CrowMotion"

# --- Flash size (4MB on the Super Mini boards; needed for OTA partitions) ---
CONFIG_ESPTOOLPY_FLASHSIZE_4MB=y
CONFIG_ESPTOOLPY_FLASHSIZE="4MB"

# --- Partition table (custom: dual-OTA + NVS) ---
CONFIG_PARTITION_TABLE_CUSTOM=y
CONFIG_PARTITION_TABLE_CUSTOM_FILENAME="partitions.csv"

# --- OTA safety: a new image must mark itself valid after boot, or the
# bootloader rolls back to the previous one on the next reset. The app calls
# esp_ota_mark_app_valid_cancel_rollback() at the end of app_main.
CONFIG_BOOTLOADER_APP_ROLLBACK_ENABLE=y

# --- Logging ---
CONFIG_LOG_DEFAULT_LEVEL_INFO=y

# --- Console over USB-C (native USB serial/JTAG) ---
CONFIG_ESP_CONSOLE_USB_SERIAL_JTAG=y

# --- Config mode: WiFi softAP + BLE coexistence, HTTP server WebSocket ---
CONFIG_ESP_COEX_SW_COEXIST_ENABLE=y
CONFIG_HTTPD_WS_SUPPORT=y

# --- Code size: build with -Os so every target fits the 1.5MB OTA slots.
# The C6 image is the largest (its radio stack); -Og overflows the slot there.
CONFIG_COMPILER_OPTIMIZATION_SIZE=y
```
